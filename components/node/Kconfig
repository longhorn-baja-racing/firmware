## components/node/Kconfig
```kconfig
menu "LBR node runtime"

    config LBR_HEALTH_PERIOD_MS
        int "Heartbeat period (ms)"
        range 100 10000
        default 1000

    config LBR_SENSOR_SIM
        bool "Use simulated sensor data (bench only)"
        default n
        help
            Replace every not-yet-implemented driver with the simulator so the
            CAN/logging/telemetry pipeline can be exercised without parts.
            Heartbeats raise the SIM_SENSORS flag and every session config
            records sim=1. Never race with this enabled.

endmenu
```

## nodes/dashboard/main/Kconfig.projbuild
```kconfig
menu "LBR dashboard (cockpit display) inputs"

    config LBR_IO_BUTTONS
        string "Slot 'buttons' input spec"
        default ""
        help
            Channels, in order: DASH_BUTTONS.
            Empty = not fitted (or simulated with LBR_SENSOR_SIM). Otherwise one
            ';'-separated entry per channel using the on-chip inputs: '-',
            'adc ...', 'pulse ...', or 'din ...'. Syntax and examples are in
            components/sensors/include/lbr/sensor_io.h and docs/sensors.md.
            The spec is the calibration and is recorded in every session.

endmenu
```

## nodes/driver_inputs/main/Kconfig.projbuild
```kconfig
menu "LBR driver_inputs inputs"

    config LBR_IO_PEDALS
        string "Slot 'pedals' input spec"
        default ""
        help
            Channels, in order: THROTTLE_POS, BRAKE_PRESS_FRONT, BRAKE_PRESS_REAR.
            Empty = not fitted (or simulated with LBR_SENSOR_SIM). Otherwise one
            ';'-separated entry per channel using the on-chip inputs: '-',
            'adc ...', 'pulse ...', or 'din ...'. Syntax and examples are in
            components/sensors/include/lbr/sensor_io.h and docs/sensors.md.
            The spec is the calibration and is recorded in every session.

    config LBR_IO_STEERING
        string "Slot 'steering' input spec"
        default ""
        help
            Channels, in order: STEERING_ANGLE.
            Empty = not fitted (or simulated with LBR_SENSOR_SIM). Otherwise one
            ';'-separated entry per channel using the on-chip inputs: '-',
            'adc ...', 'pulse ...', or 'din ...'. Syntax and examples are in
            components/sensors/include/lbr/sensor_io.h and docs/sensors.md.
            The spec is the calibration and is recorded in every session.

    config LBR_IO_BRAKE_SWITCH
        string "Slot 'brake_switch' input spec"
        default ""
        help
            Channels, in order: BRAKE_SWITCH.
            Empty = not fitted (or simulated with LBR_SENSOR_SIM). Otherwise one
            ';'-separated entry per channel using the on-chip inputs: '-',
            'adc ...', 'pulse ...', or 'din ...'. Syntax and examples are in
            components/sensors/include/lbr/sensor_io.h and docs/sensors.md.
            The spec is the calibration and is recorded in every session.

endmenu
```
