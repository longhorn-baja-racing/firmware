## car/components/can/Kconfig
```kconfig
menu "LBR CAN bus"

    config LBR_CAN_TX_GPIO
        int "TWAI TX GPIO (to transceiver TXD)"
        range -1 48
        default -1
        help
            GPIO driving the CAN transceiver TXD pin. -1 means not configured:
            pins are TBD until the node schematic is confirmed (issue #15),
            and the node refuses to start CAN while this is -1.

    config LBR_CAN_RX_GPIO
        int "TWAI RX GPIO (from transceiver RXD)"
        range -1 48
        default -1
        help
            GPIO reading the CAN transceiver RXD pin. -1 means not configured.

    config LBR_CAN_BITRATE
        int "CAN bit rate (bit/s)"
        default 500000
        help
            Shared bus bit rate; every node must use the same value.
            DAQ-WIRING.md starts at 500 kbit/s (robust on a vibrating, noisy
            car) and moves to 1 Mbit/s only if the measured bus load is too
            high. The system CAN budget in docs/can-ids.md is computed at
            this rate (about 42 % planned, ceiling 50 %).

    config LBR_CAN_RX_QUEUE_LEN
        int "RX queue length (frames)"
        default 256

    config LBR_CAN_TX_QUEUE_LEN
        int "TX queue length (frames)"
        range 8 127
        default 64
        help
            Must hold a node's worst-case burst: every slot, the heartbeat,
            and the 12 health pages can come due at the same instant, and
            the IMU Controller may forward all four corners' batches at once
            (it sets 127; checked for every plan in
            dev/tests/host/test_plans.c).

endmenu
```

## car/components/logging/Kconfig
```kconfig
menu "LBR microSD logging"

    choice LBR_SD_BUS
        prompt "microSD bus"
        default LBR_SD_BUS_SPI
        help
            Interface to the microSD socket. Confirm against the node
            schematic (issue #15).

        config LBR_SD_BUS_SPI
            bool "SPI (any GPIOs, set below)"
        config LBR_SD_BUS_SDMMC
            bool "SDMMC slot 1 (fixed ESP32 IO_MUX pins)"
    endchoice

    config LBR_SD_SPI_MOSI_GPIO
        int "SD SPI MOSI GPIO"
        depends on LBR_SD_BUS_SPI
        range -1 48
        default -1

    config LBR_SD_SPI_MISO_GPIO
        int "SD SPI MISO GPIO"
        depends on LBR_SD_BUS_SPI
        range -1 48
        default -1

    config LBR_SD_SPI_SCLK_GPIO
        int "SD SPI SCLK GPIO"
        depends on LBR_SD_BUS_SPI
        range -1 48
        default -1

    config LBR_SD_SPI_CS_GPIO
        int "SD SPI CS GPIO"
        depends on LBR_SD_BUS_SPI
        range -1 48
        default -1

    config LBR_SD_SDMMC_4BIT
        bool "SDMMC 4-bit bus (otherwise 1-bit)"
        depends on LBR_SD_BUS_SDMMC
        default n

    config LBR_SD_CD_GPIO
        int "Card-detect GPIO (-1 = none)"
        range -1 48
        default -1

    config LBR_LOG_QUEUE_KB
        int "Logger queue size (KiB)"
        range 8 160
        default 48
        help
            Bounded in-RAM queue between producers and the SD writer. Sized
            to ride out SD write stalls (a card can pause for 100s of ms
            during internal erase) at the expected record rate.

    config LBR_LOG_SYNC_INTERVAL_MS
        int "fsync interval while logging (ms)"
        range 100 10000
        default 1000
        help
            Upper bound on data lost to power loss, at the cost of more card
            wear and write latency.

endmenu
```

## car/components/transport/Kconfig
```kconfig
menu "LBR transports (gateway)"

    menu "USB serial link"
        config LBR_USB_BAUD
            int "UART0 baud rate"
            default 921600
            help
                The ESP32 talks to the host through its USB-UART bridge on
                UART0. Frames are COBS-encoded packets (packet.h); see
                dev/tools/lbr_decode.py serial for a host-side reader.

        config LBR_USB_TX_BUFFER_KB
            int "TX buffer (KiB)"
            range 4 64
            default 16
    endmenu

    menu "LoRa link (SX127x)"
        config LBR_LORA_SCLK_GPIO
            int "SPI SCLK GPIO"
            range -1 48
            default -1
        config LBR_LORA_MOSI_GPIO
            int "SPI MOSI GPIO"
            range -1 48
            default -1
        config LBR_LORA_MISO_GPIO
            int "SPI MISO GPIO"
            range -1 48
            default -1
        config LBR_LORA_CS_GPIO
            int "SPI CS (NSS) GPIO"
            range -1 48
            default -1
        config LBR_LORA_RST_GPIO
            int "Reset GPIO (-1 = not wired)"
            range -1 48
            default -1
        config LBR_LORA_DIO0_GPIO
            int "DIO0 GPIO (-1 = poll the IRQ register)"
            range -1 48
            default -1

        config LBR_LORA_FREQ_HZ
            int "Carrier frequency (Hz)"
            default 915000000
            help
                915 MHz for North America (FCC part 15.247). Use 868 MHz
                with a 1% (10 permille) duty ceiling in the EU.

        config LBR_LORA_SF
            int "Spreading factor"
            range 7 12
            default 9

        config LBR_LORA_BW_KHZ
            int "Bandwidth (kHz)"
            default 125
            help
                125, 250, or 500.

        config LBR_LORA_CR
            int "Coding rate denominator - 4 (1 = 4/5 .. 4 = 4/8)"
            range 1 4
            default 1

        config LBR_LORA_TX_DBM
            int "TX power (dBm, PA_BOOST)"
            range 2 20
            default 17

        config LBR_LORA_SYNC_WORD
            hex "Sync word"
            default 0x12
            help
                0x12 is the private-network sync word; it must match the pit
                receiver.
    endmenu

    menu "WiFi pit link"
        config LBR_WIFI_SSID
            string "Access point SSID"
            default "lbr-gateway"

        config LBR_WIFI_PASSWORD
            string "Access point WPA2 password (8+ chars; empty disables WiFi)"
            default ""
            help
                The password guards OTA and config push, so it is not
                hard-coded: set it in sdkconfig (never commit it). WiFi stays
                off while this is shorter than 8 characters.

        config LBR_WIFI_CHANNEL
            int "Channel"
            range 1 13
            default 6

        config LBR_WIFI_STREAM_PORT
            int "Live stream TCP port"
            default 5760
    endmenu

    menu "BLE walk-up diagnostics"
        config LBR_BLE_NAME
            string "Advertised name"
            default "LBR-GW"
    endmenu

endmenu
```

## car/components/wlink/Kconfig
```kconfig
menu "LBR wireless links"

    config LBR_WIFI_5GHZ
        bool "Use the 5 GHz band (ESP32-C5)"
        depends on SOC_WIFI_SUPPORT_5G
        default y
        help
            5 GHz by default; turn off to fall back to 2.4 GHz
            (DAQ-WIRING.md section 8: test both on the car). Applies to
            the Central's access point and the cockpit that joins it.

    config LBR_WIFI_SSID
        string "Central access point SSID (pit link; the cockpit joins it)"
        default "lbr-central"

    config LBR_WIFI_PASSWORD
        string "Central access point WPA2 password (8+ chars; empty disables WiFi)"
        default ""
        help
            Guards OTA and config push on the Central, so it is not
            hard-coded: set it in sdkconfig on the Central and the cockpit
            (never commit it). WiFi stays off while this is shorter than 8
            characters.

    config LBR_WIFI_CHANNEL
        int "Central access point channel"
        range 1 177
        default 36 if LBR_WIFI_5GHZ
        default 6

    config LBR_COCKPIT_ENABLE
        bool "Cockpit link over the pit access point"
        default y
        help
            The Central pushes display data to the cockpit display over
            its WiFi access point (CONFIG_LBR_WIFI_SSID / _PASSWORD), which
            the cockpit joins.

endmenu
```

## car/nodes/central/main/Kconfig.projbuild
```kconfig
menu "LBR central inputs"

    config LBR_GPS_UART_NUM
        int "GPS UART port"
        range 1 1
        default 1
        help
            UART used for the GPS module's NMEA output (the ESP32-C5 has
            UART0, the console, and UART1).

    config LBR_GPS_RX_GPIO
        int "GPS RX GPIO (module TX -> ESP32-C5)"
        range -1 28
        default -1
        help
            -1 = GPS not fitted: the GPS slot reports NOT_FITTED (or simulated
            with LBR_SENSOR_SIM). Any module with NMEA 0183 output works.
            Pin TBD from the Central's schematic.

    config LBR_GPS_TX_GPIO
        int "GPS TX GPIO (ESP32-C5 -> module RX)"
        range -1 28
        default -1
        help
            Optional; -1 = receive only (the module runs its stored config).

    config LBR_GPS_BAUD
        int "GPS baud rate"
        range 4800 921600
        default 9600
        help
            Module default is usually 9600. A 10 Hz fix rate with GGA, RMC,
            and GSA needs at least 38400.

endmenu
```

## car/nodes/cockpit/main/Kconfig.projbuild
```kconfig
menu "LBR cockpit (driver display)"

    config LBR_IO_BATTERY
        string "Slot 'battery' input spec"
        default ""
        help
            Channels, in order: COCKPIT_BATTERY (percent). Typically an
            'adc ...' entry on an ADC1 pin of the ESP32-C5 (GPIO 1..6) behind
            a divider. Empty = not fitted (or simulated with LBR_SENSOR_SIM).
            Syntax: car/components/sensors/include/lbr/sensor_io.h and
            docs/sensors.md. Battery capacity and charging are TBD. The
            cockpit joins the Central's access point
            (CONFIG_LBR_WIFI_SSID / CONFIG_LBR_WIFI_PASSWORD).

endmenu
```

## car/nodes/corner/main/Kconfig.projbuild
```kconfig
menu "LBR corner node"

    choice LBR_CORNER_POSITION_CHOICE
        prompt "Position on the car"
        default LBR_CORNER_FL
        help
            The same firmware runs on all four wheel hub nodes; this picks
            the CAN node id (7..10) and the IMU frames it sends.

        config LBR_CORNER_FL
            bool "FL (front left)"
        config LBR_CORNER_FR
            bool "FR (front right)"
        config LBR_CORNER_BL
            bool "BL (back left)"
        config LBR_CORNER_BR
            bool "BR (back right)"
    endchoice

    config LBR_CORNER_POSITION
        int
        default 0 if LBR_CORNER_FL
        default 1 if LBR_CORNER_FR
        default 2 if LBR_CORNER_BL
        default 3 if LBR_CORNER_BR

endmenu
```

## car/nodes/dashboard/main/Kconfig.projbuild
```kconfig
menu "LBR dashboard (cockpit display)"

    config LBR_IO_BATTERY
        string "Slot 'battery' input spec"
        default ""
        help
            Channels, in order: DASH_BATTERY (percent). Typically an
            'adc ...' entry on an ADC1 pin of the ESP32-C5 (GPIO 1..6) behind
            a divider. Empty = not fitted (or simulated with LBR_SENSOR_SIM).
            Syntax: car/components/sensors/include/lbr/sensor_io.h and
            docs/sensors.md. Battery capacity and charging are TBD. The
            dashboard joins the Central's access point
            (CONFIG_LBR_WIFI_SSID / CONFIG_LBR_WIFI_PASSWORD).

endmenu
```

## car/nodes/driver_input/main/Kconfig.projbuild
```kconfig
menu "LBR driver_input inputs"

    config LBR_IO_INPUTS
        string "Slot 'inputs' input spec"
        default ""
        help
            Channels, in order: BRAKE_PEDAL, GAS_PEDAL, STEERING_ANGLE (frame 0x100; typically adc inputs (potentiometers)).
            Empty = not fitted (or simulated with LBR_SENSOR_SIM). Otherwise one
            ';'-separated entry per channel using the on-chip inputs: '-',
            'adc ...', 'pulse ...', or 'din ...'. Syntax and examples are in
            car/components/sensors/include/lbr/sensor_io.h and docs/sensors.md.
            The spec is the calibration and is recorded in every session.

endmenu
```

## car/nodes/fuel_gauge/main/Kconfig.projbuild
```kconfig
menu "LBR fuel_gauge inputs"

    config LBR_IO_FUEL
        string "Slot 'fuel' input spec"
        default ""
        help
            Channels, in order: FUEL_LEVEL, FUEL_VOLUME.
            Empty = not fitted (or simulated with LBR_SENSOR_SIM). Otherwise one
            ';'-separated entry per channel using the on-chip inputs: '-',
            'adc ...', 'pulse ...', or 'din ...'. Syntax and examples are in
            car/components/sensors/include/lbr/sensor_io.h and docs/sensors.md.
            The spec is the calibration and is recorded in every session.

endmenu
```

## car/nodes/imu_gps/main/Kconfig.projbuild
```kconfig
menu "LBR imu_gps inputs"

    config LBR_GPS_UART_NUM
        int "GPS UART port"
        range 1 2
        default 2
        help
            UART used for the GPS module's NMEA output. UART0 is the console.

    config LBR_GPS_RX_GPIO
        int "GPS RX GPIO (module TX -> ESP32)"
        range -1 39
        default -1
        help
            -1 = GPS not fitted: the GPS slot reports NOT_FITTED (or simulated
            with LBR_SENSOR_SIM). Any module with NMEA 0183 output works.

    config LBR_GPS_TX_GPIO
        int "GPS TX GPIO (ESP32 -> module RX)"
        range -1 33
        default -1
        help
            Optional; -1 = receive only (the module runs its stored config).

    config LBR_GPS_BAUD
        int "GPS baud rate"
        range 4800 921600
        default 9600
        help
            Module default is usually 9600. A 10 Hz fix rate with GGA, RMC,
            and GSA needs at least 38400.

endmenu
```

## car/nodes/powertrain/main/Kconfig.projbuild
```kconfig
menu "LBR powertrain inputs"

    config LBR_IO_SPEEDS
        string "Slot 'speeds' input spec"
        default ""
        help
            Channels, in order: ENGINE_RPM, CVT_RPM (frame 0x200; typically pulse inputs (pickup or hall sensor)).
            Empty = not fitted (or simulated with LBR_SENSOR_SIM). Otherwise one
            ';'-separated entry per channel using the on-chip inputs: '-',
            'adc ...', 'pulse ...', or 'din ...'. Syntax and examples are in
            car/components/sensors/include/lbr/sensor_io.h and docs/sensors.md.
            The spec is the calibration and is recorded in every session.

    config LBR_IO_FUEL
        string "Slot 'fuel' input spec"
        default ""
        help
            Channels, in order: FUEL_LEVEL (frame 0x201; typically an adc input (fuel sender)).
            Empty = not fitted (or simulated with LBR_SENSOR_SIM). Otherwise one
            ';'-separated entry per channel using the on-chip inputs: '-',
            'adc ...', 'pulse ...', or 'din ...'. Syntax and examples are in
            car/components/sensors/include/lbr/sensor_io.h and docs/sensors.md.
            The spec is the calibration and is recorded in every session.

endmenu
```

## car/nodes/stress/main/Kconfig.projbuild
```kconfig
menu "LBR stress inputs"

    config LBR_IO_STRESS
        string "Slot 'stress' input spec"
        default ""
        help
            Channels, in order: STRESS_1, STRESS_2, STRESS_3, STRESS_4, STRESS_5, STRESS_6, STRESS_7, STRESS_8 (frames 0x400 and 0x401; needs a bridge amplifier/ADC part, the on-chip ADC is too noisy).
            Empty = not fitted (or simulated with LBR_SENSOR_SIM). Otherwise one
            ';'-separated entry per channel using the on-chip inputs: '-',
            'adc ...', 'pulse ...', or 'din ...'. Syntax and examples are in
            car/components/sensors/include/lbr/sensor_io.h and docs/sensors.md.
            The spec is the calibration and is recorded in every session.

endmenu
```
