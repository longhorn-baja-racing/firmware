## car/nodes/cockpit/main/Kconfig.projbuild
```kconfig
menu "LBR cockpit (driver display)"

    config LBR_IO_BATTERY
        string "Slot 'battery' input spec"
        default ""
        help
            Channel: COCKPIT_BATTERY (percent). Typically an 'adc ...' entry
            on an ADC1 pin of the ESP32-C5 (GPIO 1..6). Use measured voltage
            endpoints for percent calibration. Empty = not fitted (or
            simulated with LBR_SENSOR_SIM).
            Syntax: car/components/sensors/include/lbr/sensor_io.h and
            docs/sensors.md. The dashboard warns at 20% and marks 10% or less
            critical. Battery capacity and charging are TBD. The
            cockpit joins the Central's access point
            (CONFIG_LBR_WIFI_SSID / CONFIG_LBR_WIFI_PASSWORD).

endmenu
```

## car/nodes/corner/main/Kconfig.projbuild
```kconfig
menu "LBR corner node"

    config LBR_IO_BATTERY
        string "Slot 'battery' input spec"
        default ""
        help
            One channel: this corner's battery level in percent. Configure an
            ADC1 entry with calibrated voltage-to-percent endpoints. Empty means
            not fitted. The two-point linear calibration and syntax are in
            docs/sensors.md.

    choice LBR_CORNER_POSITION_CHOICE
        prompt "Position on the car"
        default LBR_CORNER_FL
        help
            The same firmware runs on all four wheel hub nodes; this picks
            the CAN node id (7..10) and the IMU frames it sends.

        config LBR_CORNER_FL
            bool "FL (front left)"
        config LBR_CORNER_FR
            bool "FR (front right)"
        config LBR_CORNER_BL
            bool "BL (back left)"
        config LBR_CORNER_BR
            bool "BR (back right)"
    endchoice

    config LBR_CORNER_POSITION
        int
        default 0 if LBR_CORNER_FL
        default 1 if LBR_CORNER_FR
        default 2 if LBR_CORNER_BL
        default 3 if LBR_CORNER_BR

endmenu
```

## lbrlib/components/lbr_links/Kconfig
```kconfig
menu "LBR live links (Central)"

    menu "USB serial link"
        config LBR_USB_BAUD
            int "UART0 baud rate"
            default 921600
            help
                The ESP32 talks to the host through its USB-UART bridge on
                UART0. Frames are COBS-encoded packets (packet.h); see
                dev/tools/lbr_decode.py serial for a host-side reader.

        config LBR_USB_TX_BUFFER_KB
            int "TX buffer (KiB)"
            range 4 64
            default 16
    endmenu

    menu "LoRa link (SX127x)"
        config LBR_LORA_SCLK_GPIO
            int "SPI SCLK GPIO"
            range -1 48
            default -1
        config LBR_LORA_MOSI_GPIO
            int "SPI MOSI GPIO"
            range -1 48
            default -1
        config LBR_LORA_MISO_GPIO
            int "SPI MISO GPIO"
            range -1 48
            default -1
        config LBR_LORA_CS_GPIO
            int "SPI CS (NSS) GPIO"
            range -1 48
            default -1
        config LBR_LORA_RST_GPIO
            int "Reset GPIO (-1 = not wired)"
            range -1 48
            default -1
        config LBR_LORA_DIO0_GPIO
            int "DIO0 GPIO (-1 = poll the IRQ register)"
            range -1 48
            default -1

        config LBR_LORA_FREQ_HZ
            int "Carrier frequency (Hz)"
            default 915000000
            help
                915 MHz for North America (FCC part 15.247). Use 868 MHz
                with a 1% (10 permille) duty ceiling in the EU.

        config LBR_LORA_SF
            int "Spreading factor"
            range 7 12
            default 9

        config LBR_LORA_BW_KHZ
            int "Bandwidth (kHz)"
            default 125
            help
                125, 250, or 500.

        config LBR_LORA_CR
            int "Coding rate denominator - 4 (1 = 4/5 .. 4 = 4/8)"
            range 1 4
            default 1

        config LBR_LORA_TX_DBM
            int "TX power (dBm, PA_BOOST)"
            range 2 20
            default 17

        config LBR_LORA_SYNC_WORD
            hex "Sync word"
            default 0x12
            help
                0x12 is the private-network sync word; it must match the pit
                receiver.
    endmenu

    menu "WiFi pit link"
        config LBR_WIFI_STREAM_PORT
            int "Live stream TCP port"
            default 5760
        comment "SSID, password, channel, and band: LBR wireless links menu"
    endmenu

    menu "BLE walk-up diagnostics"
        config LBR_BLE_NAME
            string "Advertised name"
            default "LBR-CENTRAL"
    endmenu

endmenu

menu "LBR wireless links"

    config LBR_WIFI_5GHZ
        bool "Use the 5 GHz band (ESP32-C5)"
        depends on SOC_WIFI_SUPPORT_5G
        default y
        help
            5 GHz by default; turn off to fall back to 2.4 GHz
            (DAQ-WIRING.md section 8: test both on the car). Applies to
            the Central's access point and the cockpit that joins it.

    config LBR_WIFI_SSID
        string "Central access point SSID (pit link; the cockpit joins it)"
        default "lbr-central"

    config LBR_WIFI_PASSWORD
        string "Central access point WPA2 password (8+ chars; empty disables WiFi)"
        default ""
        help
            Guards OTA and config push on the Central, so it is not
            hard-coded: set it in sdkconfig on the Central and the cockpit
            (never commit it). WiFi stays off while this is shorter than 8
            characters.

    config LBR_WIFI_CHANNEL
        int "Central access point channel"
        range 1 177
        default 36 if LBR_WIFI_5GHZ
        default 6

    config LBR_COCKPIT_ENABLE
        bool "Cockpit link over the pit access point"
        default y
        help
            The Central pushes display data to the cockpit display over
            its WiFi access point (CONFIG_LBR_WIFI_SSID / _PASSWORD), which
            the cockpit joins.

endmenu
```
